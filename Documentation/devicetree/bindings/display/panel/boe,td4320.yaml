## Documentation/devicetree/bindings/display/panel/boe,td4320.yaml
```yaml
# SPDX-License-Identifier: (GPL-2.0-only OR BSD-2-Clause)
%YAML 1.2
---
$id: http://devicetree.org/schemas/display/panel/boe,td4320.yaml#
$schema: http://devicetree.org/meta-schemas/core.yaml#

title: BOE TD4320 MIPI-DSI panels

maintainers:
  - Barnabas Czeman <barnabas.czeman@mainlining.org>

description:
  BOE TD4320 panels found in Xiaomi Redmi Note 7 and Xiaomi Mi 8 Lite
  smartphones. Without reset-gpios, the panel must already be initialized
  and powered by the bootloader. The driver then preserves the panel's
  power, reset, backlight and command state while the display controller
  starts its own scanout.

allOf:
  - $ref: panel-common.yaml#

properties:
  compatible:
    items:
      - const: boe,td4320

  reg:
    maxItems: 1

  reset-gpios:
    maxItems: 1
    description:
      Active-low panel reset. Providing this property enables driver-managed
      power, reset and full command initialization. Omitting it preserves
      the bootloader-initialized panel state.

  iovcc-supply:
    description: I/O voltage rail

  vsn-supply:
    description: Negative source voltage rail

  vsp-supply:
    description: Positive source voltage rail

required:
  - compatible
  - reg
  - port

unevaluatedProperties: false

examples:
  - |
    #include <dt-bindings/gpio/gpio.h>

    dsi {
        #address-cells = <1>;
        #size-cells = <0>;

        panel@0 {
            compatible = "boe,td4320";
            reg = <0>;
            backlight = <&backlight>;
            reset-gpios = <&tlmm 45 GPIO_ACTIVE_LOW>;

            port {
                panel_in: endpoint {
                    remote-endpoint = <&dsi_out>;
                };
            };
        };
    };

...
```

## Documentation/devicetree/bindings/power/qcom,sdm660-gfx-bhs.yaml
```yaml
# SPDX-License-Identifier: (GPL-2.0-only OR BSD-2-Clause)
%YAML 1.2
---
$id: http://devicetree.org/schemas/power/qcom,sdm660-gfx-bhs.yaml#
$schema: http://devicetree.org/meta-schemas/core.yaml#

title: Qualcomm SDM660 GFX supply in BHS mode

maintainers:
  - Bjorn Andersson <andersson@kernel.org>

description: |
  On boards that disable GFX LDO operation and CPR closed-loop control,
  the GPU is supplied from CX through the bypass head switch (BHS).
  This controller manages CX performance states, the MX vote for GPU
  PLLs, and the GFX memory-access selector. It prepares these supplies
  before enabling the GX GDSC, and releases them after GX collapses.
  Both the GPU and its SMMU use this power domain. Performance states
  use the RPM_SMD_LEVEL_* values from qcom-rpmpd.h.

properties:
  compatible:
    const: qcom,sdm660-gfx-bhs

  reg:
    items:
      - description: GFX LDO and BHS registers
      - description: GFX memory-access selector

  reg-names:
    items:
      - const: bhs
      - const: mem-acc

  '#power-domain-cells':
    const: 0

  power-domains:
    items:
      - description: CX RPM power domain
      - description: MX RPM power domain
      - description: GPU GX GDSC

  power-domain-names:
    items:
      - const: cx
      - const: mx
      - const: gx

  operating-points-v2: true

  opp-table:
    type: object

required:
  - compatible
  - reg
  - reg-names
  - '#power-domain-cells'
  - power-domains
  - power-domain-names
  - operating-points-v2

additionalProperties: false

examples:
  - |
    #include <dt-bindings/clock/qcom,gpucc-sdm660.h>
    #include <dt-bindings/power/qcom-rpmpd.h>

    power-controller@506e000 {
        compatible = "qcom,sdm660-gfx-bhs";
        reg = <0x0506e000 0x34>, <0x01fcf004 0x4>;
        reg-names = "bhs", "mem-acc";
        #power-domain-cells = <0>;
        power-domains = <&rpmpd RPMPD_VDDCX>,
                        <&rpmpd RPMPD_VDDMX>,
                        <&gpucc GPU_GX_GDSC>;
        power-domain-names = "cx", "mx", "gx";
        operating-points-v2 = <&gfx_opp_table>;

        gfx_opp_table: opp-table {
            compatible = "operating-points-v2";
            opp-48 { opp-level = <RPM_SMD_LEVEL_MIN_SVS>; };
            opp-64 { opp-level = <RPM_SMD_LEVEL_LOW_SVS>; };
            opp-128 { opp-level = <RPM_SMD_LEVEL_SVS>; };
            opp-192 { opp-level = <RPM_SMD_LEVEL_SVS_PLUS>; };
            opp-256 { opp-level = <RPM_SMD_LEVEL_NOM>; };
            opp-320 { opp-level = <RPM_SMD_LEVEL_NOM_PLUS>; };
            opp-384 { opp-level = <RPM_SMD_LEVEL_TURBO>; };
        };
    };
```

## Documentation/devicetree/bindings/sound/nxp,tfa9894.yaml
```yaml
# SPDX-License-Identifier: (GPL-2.0-only)
%YAML 1.2
---
$id: http://devicetree.org/schemas/sound/nxp,tfa9894.yaml#
$schema: http://devicetree.org/meta-schemas/core.yaml#

title: NXP/Goodix TFA9894 smart speaker amplifier

maintainers:
  - David Heidelberg <david@ixit.cz>

description:
  The TFA9894 is an I2C-controlled class-D speaker amplifier with an
  integrated CoolFlux DSP. A three-state GPIO selects the speaker firmware.

allOf:
  - $ref: dai-common.yaml#

properties:
  compatible:
    enum:
      - nxp,tfa9894

  reg:
    maxItems: 1

  reset-gpios:
    maxItems: 1

  speaker-id-gpios:
    maxItems: 1
    description: Three-state GPIO used to select the speaker vendor firmware.

  pinctrl-names:
    items:
      - const: pull_down
      - const: pull_up
      - const: no_pull

  pinctrl-0: true
  pinctrl-1: true
  pinctrl-2: true

  '#sound-dai-cells':
    const: 0

required:
  - compatible
  - reg
  - '#sound-dai-cells'
  - reset-gpios
  - speaker-id-gpios
  - pinctrl-names
  - pinctrl-0
  - pinctrl-1
  - pinctrl-2

dependencies:
  speaker-id-gpios: [pinctrl-0, pinctrl-1, pinctrl-2]

unevaluatedProperties: false

examples:
  - |
    #include <dt-bindings/gpio/gpio.h>

    i2c {
        #address-cells = <1>;
        #size-cells = <0>;

        audio-codec@34 {
            compatible = "nxp,tfa9894";
            reg = <0x34>;
            reset-gpios = <&tlmm 43 GPIO_ACTIVE_HIGH>;
            speaker-id-gpios = <&tlmm 113 GPIO_ACTIVE_HIGH>;
            pinctrl-names = "pull_down", "pull_up", "no_pull";
            pinctrl-0 = <&speaker_id_pull_down>;
            pinctrl-1 = <&speaker_id_pull_up>;
            pinctrl-2 = <&speaker_id_no_pull>;
            #sound-dai-cells = <0>;
        };
    };
```

## drivers/power/supply/qcom/Kconfig
```kconfig
config QCOM_PMIC_VOTER
	tristate

config QPNP_FG_GEN3
	tristate "QPNP GEN3 fuel gauge driver"
	depends on MFD_SPMI_PMIC
	select QCOM_PMIC_VOTER
	help
	  Say Y here to enable the GEN3 Fuel Gauge driver. This adds support
	  for battery fuel gauging and state of charge of battery connected to
	  the fuel gauge. The state of charge is reported through a BMS power
	  supply property and also sends uevents when the capacity is updated.

config QPNP_SMB2
	tristate "SMB2 Battery Charger"
	depends on MFD_SPMI_PMIC
	select QCOM_PMIC_VOTER
	help
	  Enables support for the SMB2 charging peripheral

config QPNP_REVID
	bool
	default y if QPNP_FG_GEN3 || QPNP_SMB2
	depends on SPMI

config OF_BATTERYDATA
	bool
	default y if QPNP_FG_GEN3
	depends on OF
```
